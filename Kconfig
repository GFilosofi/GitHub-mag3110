## Kconfig
```kconfig
config SENSORS_MAG3110_FEATURED
	tristate "Freescale MAG3110 e-compass sensor"
	depends on I2C && SYSFS
	default n
	help
	If you say yes here you get support for the Freescale MAG3110
	e-compass sensor. This driver can also be built as a module.
	If so, the module will be called mag3110.
```
